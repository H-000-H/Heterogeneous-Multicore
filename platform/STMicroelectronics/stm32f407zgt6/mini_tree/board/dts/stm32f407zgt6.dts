/dts-v1/;

#include "stm32f407.dtsi"
#include "stm32f407-gpio.dtsi"
#include "stm32f407-dma.dtsi"
#include "stm32f407-spi.dtsi"
#include "stm32f407-uart.dtsi"
#include "stm32f407-tim.dtsi"

/chosen {
	tick-rate = <1000>;
	heap-size = <32768>;
};

/ {
	#address-cells = <1>;
	#size-cells = <0>;

	model = "STMicro STM32F407ZGT6";
	compatible = "st,stm32f407zgt6", "st,stm32f407";
};
