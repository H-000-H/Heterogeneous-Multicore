// SPDX-License-Identifier: GPL-2.0-or-later

/*

 * STM32F407 SPI — 仅主机模式

 *

 * Bindings:

 *   stm32,spi-master / stm32,spi-host  — vfs/spi/bus/spi_bus.c

 *   heterogeneous,w25q64-master        — drivers/flash/w25q64_spi_drv.c

 *

 * 时钟/GPIO：由 CubeMX MX_SPIx_Init() 在 main pre_execution 钩子完成，

 * mini_tree 不重复配置 RCC。

 */



#include "stm32f407.dtsi"

#include <dt-bindings/spi/spi-parameter.h>

#include <dt-bindings/gpio/gpio-ctl.h>



&soc {

	spi1: spi@0 {

		compatible = "stm32,spi-master";

		reg = <0>;

		#address-cells = <1>;

		#size-cells = <0>;

		host-id = <SPI_DEFAULT_HOST_ID>;

		dma-chan = <SPI_DEFAULT_DMA_CHAN>;

		mosi-port = <DTS_GPIOA>;

		mosi-pin = <DTS_GPIO_PIN_7>;

		miso-port = <DTS_GPIOA>;

		miso-pin = <DTS_GPIO_PIN_6>;

		sclk-port = <DTS_GPIOA>;

		sclk-pin = <DTS_GPIO_PIN_5>;

		status = "disabled";



		w25q64_master: w25q64@0 {

			compatible = "heterogeneous,w25q64-master";

			reg = <0>;

			spi-mode = <SPI_DEFAULT_MODE>;

			spi-max-frequency = <SPI_DEFAULT_MAX_FREQUENCY_HZ>;

			queue-size = <SPI_DEFAULT_QUEUE_SIZE>;

			cs-port = <DTS_GPIOA>;

			cs-pin = <DTS_GPIO_PIN_4>;

			status = "disabled";

		};

	};

};

