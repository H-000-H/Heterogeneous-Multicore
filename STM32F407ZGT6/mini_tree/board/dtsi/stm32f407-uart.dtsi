// SPDX-License-Identifier: GPL-2.0-or-later
/*
 * STM32F407 UART
 *
 * Bindings:
 *   stm32,uart1 — vfs/uart/vfs-uart.c
 *
 * 时钟/GPIO：由 CubeMX MX_UART4_Init() 在 main pre_execution 钩子完成；
 * host-id 0 映射 UART4 (PA1 RX, PC10 TX)。
 */

#include "stm32f407.dtsi"
#include <dt-bindings/uart/uart-parameter.h>
#include <dt-bindings/gpio/gpio-ctl.h>

&soc {
	uart1: uart@0 {
		compatible = "stm32,uart1";
		reg = <0>;
		host-id = <0>;
		rx-port = <DTS_GPIOA>;
		rx-pin = <DTS_GPIO_PIN_1>;
		tx-port = <DTS_GPIOC>;
		tx-pin = <DTS_GPIO_PIN_10>;
		uart-trans-baund = <115200>;
		data-bit = <8>;
		stop-bit = <0>;
		parity = <0>;
		status = "okay";
	};
};
