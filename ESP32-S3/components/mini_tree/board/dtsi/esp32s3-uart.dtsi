#include <dt-bindings\uart\uart-parameter.h>
&soc {
	uart1: uart@0{
		compatible = "esp32,uart1";
		reg = <0>;
		#address-cells = <0>;
		#size-cells = <0>;
		host-id = <DTS_SPI_DEFAULT_HOST_ID>;
		status = "disabled";

	};
};

