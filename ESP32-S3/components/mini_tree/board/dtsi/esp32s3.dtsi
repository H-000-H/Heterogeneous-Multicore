// SPDX-License-Identifier: GPL-2.0-or-later
/*
 * Device Tree Source for Espressif ESP32-S3 SoC
 *
 * Included from board *.dts (可与 IP dtsi 一并 #include 在文件头).
 * Board model / aliases / &label 实例化写在 board *.dts。
 */

/ {
	compatible = "espressif,esp32s3";
	#address-cells = <1>;
	#size-cells = <0>;

	cpus {
		#address-cells = <1>;
		#size-cells = <0>;

		cpu@0 {
			device_type = "cpu";
			compatible = "espressif,xtensa-lx7";
			reg = <0>;
			clock-frequency = <240000000>;
			status = "disabled";
		};
	};

	soc: soc {
		compatible = "simple-bus";
		ranges;
		#address-cells = <1>;
		#size-cells = <0>;
	};
};
