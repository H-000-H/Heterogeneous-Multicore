// SPDX-License-Identifier: GPL-2.0-or-later
/*
 * ESP32-S3 WS2812 LED strip (RMT) — SoC default parameters
 *
 * Board-specific gpio / num-leds / status in board *.dts &ws2812 { }.
 * Binding: board/docs/devicetree.md (compatible = "esp32,ws2812").
 */

#include "esp32s3.dtsi"
#include <dt-bindings/led/ws2812-timing.h>

&soc {
	ws2812: led@0 {
		compatible = "esp32,ws2812";
		reg = <0>;
		brightness = <WS2812_DEFAULT_BRIGHTNESS>;
		bytes-per-led = <WS2812_BYTES_PER_LED>;
		color-order = "grb";
		default-timeout-ms = <WS2812_DEFAULT_TIMEOUT_MS>;
		rmt-resolution-hz = <WS2812_RMT_RESOLUTION_HZ>;
		rmt-mem-block = <WS2812_RMT_MEM_BLOCK>;
		rmt-queue-depth = <WS2812_RMT_QUEUE_DEPTH>;
		t0h-ticks = <WS2812_T0H_TICKS>;
		t0l-ticks = <WS2812_T0L_TICKS>;
		t1h-ticks = <WS2812_T1H_TICKS>;
		t1l-ticks = <WS2812_T1L_TICKS>;
		reset-ticks = <WS2812_RESET_TICKS>;
		status = "disabled";
	};
};
