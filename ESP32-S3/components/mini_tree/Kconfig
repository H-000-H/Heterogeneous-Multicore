## ESP32-S3/components/mini_tree/Kconfig
```kconfig
# mini_tree Kconfig for ESP-IDF (ESP32-S3)
# Lightweight: device tree + OSAL + bare metal only.
# All configuration options — edit .config or run `idf.py menuconfig`
# (navigate to Component config → mini_tree Configuration)

menu "mini_tree Configuration"

menu "Platform"
choice
    prompt "Target MCU"
    default PLATFORM_XTENSA
    help
      Select the target processor architecture.

config PLATFORM_XTENSA
    bool "Xtensa (ESP32)"
    help
      Espressif ESP32 series (Xtensa LX6/LX7).
endchoice
endmenu

menu "Multi-core Configuration"

config CPU_CORES
    int "Number of CPU cores"
    default 1
    range 1 2
    help
      CPU 核心数量。1 = 单核模式（默认）。
      2 = 双核 AMP 模式，Core 0 跑 RTOS，
      Core 1 跑裸机代码。
      设为 2 时板级需实现
      hal_cpu_secondary_startup()。

endmenu

menu "OSAL Backend"
choice
    prompt "RTOS backend"
    default OSAL_FREERTOS
    help
      Select the OS abstraction layer backend.

config OSAL_FREERTOS
    bool "FreeRTOS"
    help
      Use ESP-IDF built-in FreeRTOS.

config OSAL_RTTHREAD
    bool "RT-Thread"
    help
      Use RT-Thread kernel as OSAL backend.
      Note: RT-Thread kernel not bundled in this project;
      provide your own or delete this option.

config OSAL_NULL
    bool "None (bare-metal)"
    help
      No RTOS. Queue uses ring buffer + busy-wait.

endchoice

if OSAL_NULL

menu "Bare-metal Atomic Backend"

choice
    prompt "Atomic primitive backend"
    default OSAL_NULL_ATOMIC_AUTO
    help
      How osal_null.c implements mutex/spinlock/semaphore atomics.

config OSAL_NULL_ATOMIC_AUTO
    bool "Auto (prefer C11 stdatomic, fallback GCC builtins)"
    help
      Use <stdatomic.h> when the toolchain provides it;
      otherwise use GCC __atomic_* builtins.

config OSAL_NULL_ATOMIC_STDATOMIC
    bool "Force C11 stdatomic.h"
    help
      Always use C11 atomics. Build fails if unavailable.

config OSAL_NULL_ATOMIC_GCC_BUILTIN
    bool "Force GCC __atomic_* builtins"
    help
      Use compiler builtins only (no stdatomic.h).

endchoice

endmenu

endif

endmenu

menu "System Log"
choice
    prompt "Log backend"
    default SYS_LOG_USE_PRINTF
    help
      Select system log output backend.

config SYS_LOG_USE_PRINTF
    bool "Direct printf"
    help
      Output via plain printf.

config SYS_LOG_USE_OSAL
    bool "OSAL logging"
    help
      Output via OSAL log interface.

config SYS_LOG_USE_ESP
    bool "ESP-IDF logging (ESP_LOGI)"
    help
      Output via ESP-IDF's ESP_LOGI / ESP_LOGW / ESP_LOGE.
endchoice
endmenu

menu "System Backend"
choice
    prompt "System runtime implementation"
    default SYSTEM_CPP
    help
      Select C or C++ system backend.

config SYSTEM_C
    bool "C"
    help
      Pure C system runtime.

config SYSTEM_CPP
    bool "C++"
    help
      C++ system runtime (default for ESP-IDF IoT scenarios).
endchoice
endmenu

menu "Board Features"

config PRODUCTION_LOG
    bool "Production log"
    default n
    help
      Enable production-level logging.

config SAFETY_SHUTDOWN
    bool "Safety shutdown"
    default n
    help
      Enable hardware-level safety shutdown.

config ENABLE_WDT
    bool "Watchdog (TWDT + RTC WDT)"
    default y
    help
      Enable task watchdog and RTC watchdog.

config ENABLE_FLASH_SCRUBBER
    bool "Flash bit-rot scrubber background task"
    default y
    help
      Periodically scan flash and verify CRC baseline.
      Independent of ENABLE_WDT.
endmenu

menu "HAL GPIO"

config HAL_GPIO_PORT_ENUM
    bool "GPIO port enum (GPIOA/B/C for multi-port MCUs)"
    default n
    help
      Read gpio-port from device tree in hal_pin_probe (multi-port MCUs).
      When disabled, port defaults to HAL_GPIO_PORT_DEFAULT (0 / DTS_GPIOZERO).

choice HAL_GPIO_BACKEND
    prompt "GPIO driver backend"
    default HAL_GPIO_ESP32
    help
      Platform-specific GPIO implementation linked at build time.

config HAL_GPIO_ESP32
    bool "ESP-IDF gpio driver"

config HAL_GPIO_STM32
    bool "STM32 register GPIO"

config HAL_GPIO_CH32
    bool "CH32 GPIO library"

endchoice

endmenu

menu "Runtime Capacity"

config EVENT_BUS_QUEUE_LEN
    int "Event bus queue depth"
    default 64
    range 8 256

config EVENT_BUS_MAX_SUBSCRIBERS
    int "Event bus max subscribers"
    default 24
    range 4 64

config EVENT_BUS_DISPATCH_STACK
    int "Event bus dispatch task stack (bytes)"
    default 2048
    range 512 8192

config OSAL_MUTEX_POOL_SIZE
    int "OSAL static mutex pool size"
    default 24
    range 4 64

config BOARD_STACK_MONITOR_MAX_TASKS
    int "Stack monitor max registered tasks"
    default 8
    range 1 32

endmenu

menu "Compiler Compatibility"

config COMPILER_GNU_EXTENSIONS
    bool "GNU compiler extensions (container_of, likely/unlikely)"
    default y
    help
      Enable GNU statement expressions and builtins in compiler_compat.h.
      Supported by GCC and Clang.

config COMPILER_WARN_UNUSED_RESULT
    bool "Warn on ignored function results (COMPAT_WARN_UNUSED_RESULT)"
    default y
    depends on COMPILER_GNU_EXTENSIONS
    help
      Annotate critical APIs so the compiler warns when return values
      are discarded. Use COMPAT_IGNORE_RESULT() to silence intentionally.

endmenu

menu "Build Options"

config BUILD_DISASM
    bool "Generate disassembly listing"
    default y
    help
      Generate .lst disassembly listing after build.
      Build-time artifact only; does not affect Flash/RAM usage.
endmenu

endmenu
```
