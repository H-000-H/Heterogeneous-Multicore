// SPDX-License-Identifier: GPL-2.0-or-later

/*

 * CH32V307 SPI — 仅主机模式

 *

 * Bindings:

 *   ch32,spi-master / ch32,spi-host  — bus/spi/spi_bus.c

 *   heterogeneous,w25q64-master      — drivers/flash/w25q64_spi_drv.c

 *

 * 时钟/GPIO：由 MounRiver/Cube 生成代码在板级 init 中完成。

 */



#include "ch32v307.dtsi"

#include <dt-bindings/spi/spi-parameter.h>

#include <dt-bindings/gpio/gpio-ctl.h>



&soc {

	spi1: spi@0 {

		compatible = "ch32,spi-master";

		reg = <0>;

		#address-cells = <1>;

		#size-cells = <0>;

		host-id = <SPI_DEFAULT_HOST_ID>;

		dma-chan = <SPI_DEFAULT_DMA_CHAN>;

		mosi-port = <DTS_GPIOA>;

		mosi-pin = <DTS_GPIO_PIN_7>;

		miso-port = <DTS_GPIOA>;

		miso-pin = <DTS_GPIO_PIN_6>;

		sclk-port = <DTS_GPIOA>;

		sclk-pin = <DTS_GPIO_PIN_5>;

		status = "disabled";



		w25q64_master: w25q64@0 {

			compatible = "heterogeneous,w25q64-master";

			reg = <0>;

			spi-mode = <SPI_DEFAULT_MODE>;

			spi-max-frequency = <SPI_DEFAULT_MAX_FREQUENCY_HZ>;

			queue-size = <SPI_DEFAULT_QUEUE_SIZE>;

			cs-port = <DTS_GPIOA>;

			cs-pin = <DTS_GPIO_PIN_4>;

			status = "disabled";

		};

	};

};

