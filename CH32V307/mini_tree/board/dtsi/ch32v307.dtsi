// SPDX-License-Identifier: GPL-2.0-or-later
/*
 * Device Tree Source for WCH CH32V307 SoC
 *
 * Included from board *.dts (可与 IP dtsi 一并 #include 在文件头).
 * Board model / aliases / &label 实例化写在 board *.dts。
 */

/ {
	compatible = "wch,ch32v307";
	#address-cells = <1>;
	#size-cells = <0>;

	cpus {
		#address-cells = <1>;
		#size-cells = <0>;

		cpu@0 {
			device_type = "cpu";
			compatible = "wch,riscv";
			reg = <0>;
			clock-frequency = <144000000>;
			status = "disabled";
		};
	};

	soc: soc {
		compatible = "simple-bus";
		ranges;
		#address-cells = <1>;
		#size-cells = <0>;
	};
};
